## boards/shields/cweep/Kconfig.shield
```kconfig
config SHIELD_CWEEP_LEFT
    def_bool $(shields_list_contains,cweep_left)

config SHIELD_CWEEP_RIGHT
    def_bool $(shields_list_contains,cweep_right)

config SHIELD_CWEEP_DONGLE
    def_bool $(shields_list_contains,cweep_dongle)
```
